## boards/shields/ijskegel54/Kconfig.defconfig
```kconfig
if SHIELD_IJSKEGEL54_LEFT

config ZMK_KEYBOARD_NAME
    default "ijskegel54"

config ZMK_SPLIT_ROLE_CENTRAL
    default y

endif # SHIELD_IJSKEGEL54_LEFT

if SHIELD_IJSKEGEL54_LEFT || SHIELD_IJSKEGEL54_RIGHT

config ZMK_SPLIT
    default y

endif # SHIELD_IJSKEGEL54_LEFT || SHIELD_IJSKEGEL54_RIGHT
```

## boards/shields/ijskegel54/Kconfig.shield
```kconfig
config SHIELD_IJSKEGEL54_LEFT
    def_bool $(shields_list_contains,ijskegel54_left)

config SHIELD_IJSKEGEL54_RIGHT
    def_bool $(shields_list_contains,ijskegel54_right)
```
